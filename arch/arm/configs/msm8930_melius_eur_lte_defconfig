## arch/arm/configs/msm8930_melius_eur_lte_defconfig
```kconfig
CONFIG_MACH_MELIUS_EUR_LTE=y
CONFIG_WCNSS_CCX=y
CONFIG_MUIC_AUDIO_OUTPUT_CONTROL=y

# SSWAP
CONFIG_SWAP=y
CONFIG_FRONTSWAP=y
CONFIG_ZSMALLOC_NEW=y
CONFIG_PGTABLE_MAPPING=y
CONFIG_ZSWAP=y
CONFIG_DIRECT_RECLAIM_FILE_PAGES_ONLY=n
CONFIG_INCREASE_MAXIMUM_SWAPPINESS=y
CONFIG_FIX_INACTIVE_RATIO=y
CONFIG_TIGHT_PGDAT_BALANCE=y
CONFIG_VNSWAP=y
CONFIG_SWAP_ENABLE_READAHEAD=n
```
